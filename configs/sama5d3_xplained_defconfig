## configs/sama5d3_xplained_defconfig
```kconfig
CONFIG_TARGET_at91=y
CONFIG_TARGET_at91_sama5=y
CONFIG_TARGET_at91_sama5_DEVICE_at91-sama5d3_xplained=y
CONFIG_HAS_SUBTARGETS=y
CONFIG_HAS_DEVICES=y
CONFIG_TARGET_BOARD="at91"
CONFIG_TARGET_SUBTARGET="sama5"
CONFIG_TARGET_PROFILE="DEVICE_at91-sama5d3_xplained"
CONFIG_TARGET_ARCH_PACKAGES="arm_cortex-a5"
CONFIG_DEFAULT_TARGET_OPTIMIZATION="-O3 -pipe -mcpu=cortex-a5 -mfpu=vfpv4-d16 -mfloat-abi=hard"
CONFIG_CPU_TYPE="cortex-a5"
# CONFIG_TARGET_ROOTFS_SQUASHFS is not set
# CONFIG_TARGET_IMAGES_GZIP is not set
CONFIG_DEVEL=y
CONFIG_EXTERNAL_KERNEL_TREE=""
CONFIG_KERNEL_GIT_CLONE_URI="https://github.com/linux4sam/linux-at91.git"
CONFIG_KERNEL_GIT_LOCAL_REPOSITORY=""
CONFIG_KERNEL_GIT_REF="linux4sam-2020.10"
CONFIG_NEED_TOOLCHAIN=y
CONFIG_TOOLCHAINOPTS=y
CONFIG_LIBC_USE_GLIBC=y
CONFIG_GDB=y
CONFIG_USE_GLIBC=y
CONFIG_LIBC="glibc"
CONFIG_TARGET_SUFFIX="gnueabi"
CONFIG_IMAGEOPT=y
CONFIG_PREINITOPT=y
CONFIG_INITOPT=y
CONFIG_VERSIONOPT=y
CONFIG_VERSION_DIST="Openwrt"
CONFIG_VERSION_NUMBER=""
CONFIG_VERSION_CODE="linux4sam-2020.10"
CONFIG_VERSION_REPO="http://downloads.openwrt.org/releases/19.07.2"
CONFIG_VERSION_MANUFACTURER="Microchip Technology Inc"
CONFIG_VERSION_MANUFACTURER_URL="www.microchip.com"
CONFIG_VERSION_BUG_URL=""
CONFIG_VERSION_SUPPORT_URL=""
CONFIG_VERSION_PRODUCT="SAMA5D3_Xplained"
CONFIG_VERSION_HWREV="sama5d36"
CONFIG_VERSION_FILENAMES=y
CONFIG_VERSION_CODE_FILENAMES=y
CONFIG_PER_FEED_REPO=y
CONFIG_PER_FEED_REPO_ADD_DISABLED=y
CONFIG_PER_FEED_REPO_ADD_COMMENTED=y
CONFIG_FEED_packages=y
CONFIG_FEED_luci=y
CONFIG_FEED_routing=y
CONFIG_FEED_telephony=y
CONFIG_PACKAGE_luci=y
CONFIG_PACKAGE_luci-ssl-openssl=y
CONFIG_PACKAGE_kmod-wilc-sdio=y
CONFIG_PACKAGE_wireless-tools=y
CONFIG_PACKAGE_wireless-regdb=y
CONFIG_PACKAGE_wpa-supplicant=y
CONFIG_PACKAGE_hostapd=y
CONFIG_PACKAGE_hostapd-common=y
CONFIG_PACKAGE_bluez-libs=y
CONFIG_PACKAGE_bluez-daemon=y
CONFIG_PACKAGE_bluez-examples=y
CONFIG_PACKAGE_bluez-utils=y
CONFIG_PACKAGE_tcpdump=y
CONFIG_PACKAGE_kmod-lib80211=y
CONFIG_PACKAGE_kmod-cfg80211=y
CONFIG_BUSYBOX_CUSTOM=y
CONFIG_BUSYBOX_CONFIG_TFTP=y
CONFIG_BUSYBOX_CONFIG_TFTPD=y
CONFIG_BUSYBOX_CONFIG_FEATURE_TFTP_GET=y
CONFIG_BUSYBOX_CONFIG_FEATURE_TFTP_PUT=y
CONFIG_BUSYBOX_CONFIG_FEATURE_TFTP_BLOCKSIZE=y
CONFIG_BUSYBOX_CONFIG_TFTP_DEBUG=y
CONFIG_PACKAGE_rsync=y
```
